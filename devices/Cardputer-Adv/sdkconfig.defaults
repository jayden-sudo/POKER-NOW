## devices/Cardputer-Adv/sdkconfig.defaults
```kconfig
# --- 目標晶片:ESP32-S3FN8(雙核 240MHz;flash 封裝內 8MB)---
CONFIG_IDF_TARGET="esp32s3"
CONFIG_ESP_DEFAULT_CPU_FREQ_MHZ_240=y

# --- 控制台必須走 USB-Serial-JTAG(USB-C 原生 USB):
#     UART0 預設腳 G43/G44 已被 I2S LRCK 與 IR 佔用(參考 §5.3),嚴禁 UART0 ---
CONFIG_ESP_CONSOLE_USB_SERIAL_JTAG=y

# --- Flash 8MB QIO + 自訂分區(容 app + voice)---
CONFIG_ESPTOOLPY_FLASHSIZE_8MB=y
CONFIG_ESPTOOLPY_FLASHSIZE="8MB"
CONFIG_ESPTOOLPY_FLASHMODE_QIO=y
CONFIG_PARTITION_TABLE_CUSTOM=y
CONFIG_PARTITION_TABLE_CUSTOM_FILENAME="partitions.csv"

# --- 無 PSRAM(ESP32-S3FN8):嚴禁出現任何 CONFIG_SPIRAM* 行 ---
#     (勿照抄 StickS3/xingzhi 的 SPIRAM 三行;誤開會在啟動時 PSRAM 探測失敗甚至
#      佔用引腳。本檔以「不出現」為正確狀態,建置後可用
#      grep -c SPIRAM build/sdkconfig 應僅見 is-not-set 註釋行交叉檢查)

# --- 主棧 & FreeRTOS(產品 §8.1:無 opus,8KB 足;1000Hz 供 10ms 去抖/20ms 音訊節拍)---
CONFIG_ESP_MAIN_TASK_STACK_SIZE=8192
CONFIG_FREERTOS_HZ=1000

# --- LVGL 字體(四機統一三檔:14/20/28)---
CONFIG_LV_FONT_MONTSERRAT_14=y
CONFIG_LV_FONT_MONTSERRAT_20=y
CONFIG_LV_FONT_MONTSERRAT_28=y

# --- Wi-Fi 僅用於 ESP-NOW:關 AMPDU 省內存(demo 已驗證;無 PSRAM 板尤其要省)---
CONFIG_ESP_WIFI_AMPDU_TX_ENABLED=n
CONFIG_ESP_WIFI_AMPDU_RX_ENABLED=n
```

## devices/StickS3/sdkconfig.defaults
```kconfig
# --- 目標晶片:ESP32-S3-PICO-1-N8R8 ---
CONFIG_IDF_TARGET="esp32s3"
CONFIG_ESP_DEFAULT_CPU_FREQ_MHZ_240=y

# --- 控制台走 USB-Serial-JTAG(USB-C 原生 USB)---
CONFIG_ESP_CONSOLE_USB_SERIAL_JTAG=y

# --- Flash 8MB QIO + 自訂分區(容 app + voice)---
CONFIG_ESPTOOLPY_FLASHSIZE_8MB=y
CONFIG_ESPTOOLPY_FLASHSIZE="8MB"
CONFIG_ESPTOOLPY_FLASHMODE_QIO=y
CONFIG_PARTITION_TABLE_CUSTOM=y
CONFIG_PARTITION_TABLE_CUSTOM_FILENAME="partitions.csv"

# --- 8MB Octal PSRAM(N8R8;佔用 GPIO35/36/37)---
CONFIG_SPIRAM=y
CONFIG_SPIRAM_MODE_OCT=y
CONFIG_SPIRAM_SPEED_80M=y

# --- 主棧 & FreeRTOS(產品 §8.1:主棧 8KB,本機無 opus 不需 12KB)---
CONFIG_ESP_MAIN_TASK_STACK_SIZE=8192
CONFIG_FREERTOS_HZ=1000

# --- LVGL 字體(標題 14 / 內文 20 / big 28)---
CONFIG_LV_FONT_MONTSERRAT_14=y
CONFIG_LV_FONT_MONTSERRAT_20=y
CONFIG_LV_FONT_MONTSERRAT_28=y

# --- Wi-Fi 僅用於 ESP-NOW:關 AMPDU 省內存(demo 已驗證)---
CONFIG_ESP_WIFI_AMPDU_TX_ENABLED=n
CONFIG_ESP_WIFI_AMPDU_RX_ENABLED=n
```

## devices/xingzhi-cube-1.54tft-wifi/sdkconfig.defaults
```kconfig
# --- 目標晶片:ESP32-S3(雙核 240MHz)---
CONFIG_IDF_TARGET="esp32s3"
CONFIG_ESP_DEFAULT_CPU_FREQ_MHZ_240=y

# --- 控制台走 USB-Serial-JTAG(USB-C,GPIO19/20;demo 同)---
CONFIG_ESP_CONSOLE_USB_SERIAL_JTAG=y

# --- Flash 8MB QIO(Winbond W25Q64,demo 已驗證 QIO;此處與 zuowei 的 DIO 不同,勿互抄)---
CONFIG_ESPTOOLPY_FLASHSIZE_8MB=y
CONFIG_ESPTOOLPY_FLASHSIZE="8MB"
CONFIG_ESPTOOLPY_FLASHMODE_QIO=y
# demo 用 SINGLE_APP_LARGE;poker 換自訂分區容 voice(§12.2)
CONFIG_PARTITION_TABLE_CUSTOM=y
CONFIG_PARTITION_TABLE_CUSTOM_FILENAME="partitions.csv"

# --- 內置 8MB Octal PSRAM(硬性 OCT,§11)---
CONFIG_SPIRAM=y
CONFIG_SPIRAM_MODE_OCT=y
CONFIG_SPIRAM_SPEED_80M=y

# --- 主棧 & FreeRTOS(demo 12288 是給 opus 的;撲克無 opus → 8192,§12.1)---
CONFIG_ESP_MAIN_TASK_STACK_SIZE=8192
CONFIG_FREERTOS_HZ=1000

# --- LVGL 字體(四機統一三檔:14/20/28)---
CONFIG_LV_FONT_MONTSERRAT_14=y
CONFIG_LV_FONT_MONTSERRAT_20=y
CONFIG_LV_FONT_MONTSERRAT_28=y

# --- Wi-Fi 僅用於 ESP-NOW:關 AMPDU 省內存(demo 已驗證)---
CONFIG_ESP_WIFI_AMPDU_TX_ENABLED=n
CONFIG_ESP_WIFI_AMPDU_RX_ENABLED=n
```

## devices/zuowei-c3-lcd-pwr/sdkconfig.defaults
```kconfig
# --- 目標晶片:ESP32-C3(單核 RISC-V @160MHz)---
CONFIG_IDF_TARGET="esp32c3"
CONFIG_ESP_DEFAULT_CPU_FREQ_MHZ_160=y

# --- 控制台必須走 USB-Serial-JTAG:UART0 預設腳 GPIO20/21 已被 VB6824 與 USB 檢測佔用 ---
CONFIG_ESP_CONSOLE_USB_SERIAL_JTAG=y

# --- Flash 8MB **DIO** + 自訂分區(容 app + voice)---
# ★★ 嚴禁改 QIO(勿照抄 StickS3):本板 Zbit 25VQ64 跑 DIO,GPIO12/13 因 DIO 才空閒,
#    QIO 會把它們收回作 WP/HD → LCD 片選與電源自鎖雙雙失效(黑屏 + 開機即斷電)。
CONFIG_ESPTOOLPY_FLASHSIZE_8MB=y
CONFIG_ESPTOOLPY_FLASHSIZE="8MB"
CONFIG_ESPTOOLPY_FLASHMODE_DIO=y
CONFIG_PARTITION_TABLE_CUSTOM=y
CONFIG_PARTITION_TABLE_CUSTOM_FILENAME="partitions.csv"

# --- 主棧 & FreeRTOS(§12:無 opus,8KB 足;FREERTOS_HZ=1000 供 10ms 去抖/20ms 音訊節拍)---
CONFIG_ESP_MAIN_TASK_STACK_SIZE=8192
CONFIG_FREERTOS_HZ=1000

# --- VB6824:UART1,輸入 Opus16k(不用)+ 輸出 PCM16k,發送用任務(demo 驗證組合)---
CONFIG_VB6824_UART_PORT=1
CONFIG_VB6824_TYPE_OPUS_16K_20MS_PCM_16K=y
CONFIG_VB6824_SEND_USE_TASK=y
# CONFIG_VB6824_OTA_SUPPORT is not set

# --- LVGL 字體(與 StickS3 同三檔:14/20/28)---
CONFIG_LV_FONT_MONTSERRAT_14=y
CONFIG_LV_FONT_MONTSERRAT_20=y
CONFIG_LV_FONT_MONTSERRAT_28=y

# --- Wi-Fi 僅用於 ESP-NOW:C3 無 PSRAM,收緊緩衝 + 關 AMPDU(demo 實機驗證值)---
CONFIG_ESP_WIFI_STATIC_RX_BUFFER_NUM=6
CONFIG_ESP_WIFI_DYNAMIC_RX_BUFFER_NUM=8
CONFIG_ESP_WIFI_DYNAMIC_TX_BUFFER_NUM=8
CONFIG_ESP_WIFI_AMPDU_TX_ENABLED=n
CONFIG_ESP_WIFI_AMPDU_RX_ENABLED=n
```
